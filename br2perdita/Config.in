## br2perdita/Config.in
```kconfig
config BR2_PERDITA
	bool "perdita"
	select BR2_CHENXING
	select BR2_LINUX_KERNEL

config BR2_PERDITA_MAIN
	bool "perdita main"
	select BR2_PERDITA

config BR2_PERDITA_RESCUE
	bool "perdita rescue"
	select BR2_PERDITA
	select BR2_PACKAGE_DGPRESCUE

if BR2_PERDITA

config BR2_LINUX_KERNEL_CUSTOM_CONFIG_FILE
	default "$(BR2_EXTERNAL_PERDITA_PATH)/board/thingyjp/perdita/linux.config"

config BR2_LINUX_KERNEL_INTREE_DTS_NAME
	default "mstar-pioneer3-ssd210-perdita"

endif
```

## br2perdita/board/thingyjp/perdita/rescue.its
```
/dts-v1/;

/ {
	description = "Perdita Rescue FIT";
	#address-cells = <1>;

	images {
		kernel-0 {
			data = /incbin/("../../images/zImage");
			type = "kernel";
			arch = "arm";
			os = "linux";
			compression = "none";
			load = <0x21800000>;
                        entry = <0x21800000>;
			hash-1 {
				algo = "crc32";
			};
			hash-2 {
				algo = "sha1";
			};
		};
		fdt-0 {
			data = /incbin/("../../images/mstar-pioneer3-ssd210-perdita-rescue.dtb");
			type = "flat_dt";
			arch = "arm";
			compression = "none";
			hash-1 {
				algo = "crc32";
			};
			hash-2 {
				algo = "sha1";
			};
		};
		fdt-picow {
			data = /incbin/("../../images/mstar-pioneer3-ssd210-100ask-dongshanpipicow.dtb");
			type = "flat_dt";
			arch = "arm";
			compression = "none";
			load = <0x22d00000>;
			hash-1 {
				algo = "crc32";
			};
			hash-2 {
				algo = "sha1";
			};
		};
		fdt-picow-snander {
			data = /incbin/("../../images/mstar-pioneer3-ssd210-100ask-dongshanpipicow-snander.dtb");
			type = "flat_dt";
			arch = "arm";
			compression = "none";
			load = <0x22e00000>;
			hash-1 {
				algo = "crc32";
			};
			hash-2 {
				algo = "sha1";
			};
		};
		ramdisk-0 {
			data = /incbin/("../../images/rootfs.cpio.lz4");
			type = "ramdisk";
			arch = "arm";
			os = "linux";
			compression = "none";
			hash-1 {
				algo = "crc32";
			};
			hash-2 {
				algo = "sha1";
			};
		};
	};

	configurations {
		default = "ssd210-perdita";
		ssd210-perdita {
			description = "thiny.jp perdita";
			kernel = "kernel-0";
			fdt = "fdt-0";
			ramdisk = "ramdisk-0";
		};
		ssd210-picow {
			description = "100ask picow";
			kernel = "kernel-0";
			fdt = "fdt-picow";
			ramdisk = "ramdisk-0";
		};
		ssd210-picow-snander {
			description = "100ask picow, snander overlay";
			fdt = "fdt-picow-snander";
		};
	};
};
```

## br2perdita/configs/perdita_defconfig
```kconfig
BR2_arm=y
BR2_cortex_a7=y
BR2_ARM_FPU_NEON_VFPV4=y
BR2_BINUTILS_VERSION_2_39_X=y
BR2_GCC_VERSION_12_X=y
BR2_TOOLCHAIN_BUILDROOT_CXX=y
BR2_PACKAGE_HOST_GDB=y
BR2_CPAN_MIRROR="http://cpan.metacpan.org"
BR2_ENABLE_DEBUG=y
BR2_ENABLE_LTO=y
BR2_REPRODUCIBLE=y
# BR2_PIC_PIE is not set
BR2_SSP_NONE=y
BR2_RELRO_NONE=y
BR2_FORTIFY_SOURCE_NONE=y
BR2_TARGET_GENERIC_HOSTNAME="perdita"
BR2_TARGET_GENERIC_ISSUE="Welcome to Perdita!"
BR2_TARGET_GENERIC_GETTY_PORT="ttyS0"
# BR2_TARGET_GENERIC_REMOUNT_ROOTFS_RW is not set
BR2_ENABLE_LOCALE_WHITELIST="C"
BR2_ROOTFS_USERS_TABLES="$(BR2_EXTERNAL_PERDITA_PATH)/users"
BR2_ROOTFS_OVERLAY="$(BR2_EXTERNAL_CHENXING_PATH)/overlay/ $(BR2_EXTERNAL_PERDITA_PATH)/board/thingyjp/perdita/overlay/"
BR2_ROOTFS_POST_BUILD_SCRIPT="$(BR2_EXTERNAL_PERDITA_PATH)/board/thingyjp/perdita/post-build.sh"
BR2_ROOTFS_POST_IMAGE_SCRIPT="support/scripts/genimage.sh"
BR2_ROOTFS_POST_SCRIPT_ARGS="-c $(BR2_EXTERNAL_PERDITA_PATH)/board/thingyjp/perdita/genimage.cfg"
BR2_LINUX_KERNEL_CUSTOM_GIT=y
BR2_LINUX_KERNEL_USE_CUSTOM_CONFIG=y
BR2_LINUX_KERNEL_XZ=y
BR2_LINUX_KERNEL_INTREE_DTS_NAME="mstar-pioneer3-ssd210-perdita mstar-pioneer3-ssd210-100ask-dongshanpipicow"
BR2_PACKAGE_BUSYBOX_CONFIG_FRAGMENT_FILES="$(BR2_EXTERNAL_PERDITA_PATH)/board/thingyjp/perdita/busybox.frag"
BR2_PACKAGE_ALSA_UTILS=y
# BR2_PACKAGE_ALSA_UTILS_ALSACTL is not set
BR2_PACKAGE_ALSA_UTILS_SPEAKER_TEST=y
BR2_PACKAGE_GDB=y
BR2_PACKAGE_MTD=y
# BR2_PACKAGE_MTD_FLASHCP is not set
# BR2_PACKAGE_MTD_FLASH_ERASE is not set
# BR2_PACKAGE_MTD_FLASH_LOCK is not set
# BR2_PACKAGE_MTD_FLASH_UNLOCK is not set
# BR2_PACKAGE_MTD_MTD_DEBUG is not set
# BR2_PACKAGE_MTD_NANDDUMP is not set
# BR2_PACKAGE_MTD_NANDTEST is not set
# BR2_PACKAGE_MTD_NANDWRITE is not set
# BR2_PACKAGE_MTD_MTDINFO is not set
# BR2_PACKAGE_MTD_UBIATTACH is not set
# BR2_PACKAGE_MTD_UBICRC32 is not set
# BR2_PACKAGE_MTD_UBIDETACH is not set
# BR2_PACKAGE_MTD_UBIFORMAT is not set
# BR2_PACKAGE_MTD_UBIMKVOL is not set
# BR2_PACKAGE_MTD_UBINFO is not set
# BR2_PACKAGE_MTD_UBINIZE is not set
# BR2_PACKAGE_MTD_UBIRENAME is not set
# BR2_PACKAGE_MTD_UBIRMVOL is not set
# BR2_PACKAGE_MTD_UBIRSVOL is not set
# BR2_PACKAGE_MTD_UBIBLOCK is not set
BR2_PACKAGE_CHOCOLATE_DOOM=y
BR2_PACKAGE_DOOM_WAD=y
BR2_PACKAGE_ALSA_LIB_PCM_PLUGINS="hw"
BR2_PACKAGE_ALSA_LIB_CTL_PLUGINS="hw"
# BR2_PACKAGE_ALSA_LIB_ALOAD is not set
# BR2_PACKAGE_ALSA_LIB_RAWMIDI is not set
# BR2_PACKAGE_ALSA_LIB_UCM is not set
# BR2_PACKAGE_ALSA_LIB_ALISP is not set
# BR2_PACKAGE_ALSA_LIB_OLD_SYMBOLS is not set
# BR2_PACKAGE_ALSA_LIB_TOPOLOGY is not set
BR2_PACKAGE_OPENSSL=y
BR2_PACKAGE_LIBDRM_INSTALL_TESTS=y
BR2_PACKAGE_LIBGPIOD=y
BR2_PACKAGE_LIBGPIOD_TOOLS=y
BR2_PACKAGE_LIBCURL=y
BR2_PACKAGE_LIBCURL_CURL=y
# BR2_PACKAGE_LIBCURL_PROXY_SUPPORT is not set
# BR2_PACKAGE_LIBCURL_COOKIES_SUPPORT is not set
# BR2_PACKAGE_LIBCURL_EXTRA_PROTOCOLS_FEATURES is not set
BR2_PACKAGE_LIBFFI=y
BR2_PACKAGE_DROPBEAR=y
BR2_PACKAGE_WIRELESS_REGDB=y
# BR2_PACKAGE_URANDOM_SCRIPTS is not set
BR2_PACKAGE_SUDO=y
BR2_PACKAGE_NANO=y
BR2_TARGET_ROOTFS_CPIO=y
BR2_TARGET_ROOTFS_CPIO_GZIP=y
BR2_TARGET_ROOTFS_SQUASHFS=y
BR2_TARGET_ROOTFS_SQUASHFS4_XZ=y
BR2_TARGET_ROOTFS_SQUASHFS_EXTREME_COMP=y
# BR2_TARGET_ROOTFS_TAR is not set
BR2_TARGET_UBOOT=y
BR2_TARGET_UBOOT_BUILD_SYSTEM_KCONFIG=y
BR2_TARGET_UBOOT_CUSTOM_GIT=y
BR2_TARGET_UBOOT_CUSTOM_REPO_VERSION="mstar_rebase_mainline_20220624_p3_ddr_work"
BR2_TARGET_UBOOT_BOARD_DEFCONFIG="mstar_pioneer3_predita"
BR2_TARGET_UBOOT_NEEDS_DTC=y
# BR2_TARGET_UBOOT_FORMAT_BIN is not set
BR2_TARGET_UBOOT_FORMAT_IMG=y
BR2_TARGET_UBOOT_SPL=y
BR2_TARGET_UBOOT_SPL_NAME="ipl"
BR2_PACKAGE_AUTOSSHKEY=y
BR2_PACKAGE_AUTOSSHKEY_USERS="perdita"
BR2_PACKAGE_AUTOSSHKEY_SUDOUSERS="perdita"
BR2_PACKAGE_SANETIME=y
BR2_PACKAGE_DIRECTFB2_GE=y
BR2_PACKAGE_HOST_MSTARBINTOOLS=y
BR2_PACKAGE_XMP=y
BR2_PACKAGE_MHZ=y
BR2_PACKAGE_GT=y
BR2_PERDITA_MAIN=y
BR2_PACKAGE_FAKE08=y
BR2_PACKAGE_MEDNAFEN=y
BR2_PACKAGE_SCUMMVM=y
BR2_PACKAGE_SCUMMVM_DISABLE_SCALERS=y
BR2_PACKAGE_DIRECTFB2=y
BR2_PACKAGE_DIRECTFB2_DRMKMS=y
BR2_PACKAGE_DIRECTFB2_TOOLS=y
BR2_PACKAGE_SDL2_DIRECTFB2=y
```

## br2perdita/configs/perdita_rescue_defconfig
```kconfig
BR2_arm=y
BR2_cortex_a7=y
BR2_ARM_FPU_NEON_VFPV4=y
BR2_TOOLCHAIN_BUILDROOT_MUSL=y
BR2_BINUTILS_VERSION_2_39_X=y
BR2_GCC_VERSION_12_X=y
BR2_CPAN_MIRROR="http://cpan.metacpan.org"
BR2_REPRODUCIBLE=y
# BR2_PIC_PIE is not set
BR2_SSP_NONE=y
BR2_RELRO_NONE=y
BR2_TARGET_GENERIC_HOSTNAME="perdita-rescue"
BR2_TARGET_GENERIC_ISSUE="Welcome to Perdita Rescue (Buildroot)"
BR2_TARGET_GENERIC_GETTY_PORT="ttyS0"
# BR2_TARGET_GENERIC_REMOUNT_ROOTFS_RW is not set
BR2_ENABLE_LOCALE_WHITELIST="C"
BR2_ROOTFS_OVERLAY="$(BR2_EXTERNAL_CHENXING_PATH)/overlay/"
BR2_ROOTFS_POST_IMAGE_SCRIPT="support/scripts/genimage.sh"
BR2_ROOTFS_POST_SCRIPT_ARGS="-c $(BR2_EXTERNAL_PERDITA_PATH)/board/thingyjp/perdita/genimage_rescue.cfg"
BR2_LINUX_KERNEL_CUSTOM_GIT=y
BR2_LINUX_KERNEL_USE_CUSTOM_CONFIG=y
BR2_LINUX_KERNEL_CONFIG_FRAGMENT_FILES="$(BR2_EXTERNAL_PERDITA_PATH)/board/thingyjp/perdita/kernel_rescue.fragment"
BR2_LINUX_KERNEL_INTREE_DTS_NAME="mstar-pioneer3-ssd210-perdita-rescue mstar-pioneer3-ssd210-100ask-dongshanpipicow mstar-pioneer3-ssd210-100ask-dongshanpipicow-snander"
BR2_PACKAGE_BUSYBOX_CONFIG_FRAGMENT_FILES="$(BR2_EXTERNAL_PERDITA_PATH)/board/thingyjp/perdita/busybox.frag"
# BR2_PACKAGE_MTD_FLASHCP is not set
# BR2_PACKAGE_MTD_FLASH_LOCK is not set
# BR2_PACKAGE_MTD_FLASH_UNLOCK is not set
# BR2_PACKAGE_MTD_MTD_DEBUG is not set
# BR2_PACKAGE_MTD_NANDDUMP is not set
# BR2_PACKAGE_MTD_NANDTEST is not set
# BR2_PACKAGE_MTD_MTDINFO is not set
# BR2_PACKAGE_MTD_UBICRC32 is not set
# BR2_PACKAGE_MTD_UBIHEALTHD is not set
# BR2_PACKAGE_MTD_UBIMKVOL is not set
# BR2_PACKAGE_MTD_UBINFO is not set
# BR2_PACKAGE_MTD_UBINIZE is not set
# BR2_PACKAGE_MTD_UBIRENAME is not set
# BR2_PACKAGE_MTD_UBIRMVOL is not set
# BR2_PACKAGE_MTD_UBIRSVOL is not set
# BR2_PACKAGE_MTD_UBIBLOCK is not set
BR2_PACKAGE_LRZSZ=y
# BR2_PACKAGE_URANDOM_SCRIPTS is not set
BR2_TARGET_ROOTFS_CPIO=y
BR2_TARGET_ROOTFS_CPIO_LZ4=y
# BR2_TARGET_ROOTFS_TAR is not set
BR2_PACKAGE_SNANDER=y
BR2_PACKAGE_SNANDER_MSTARDDC=y
BR2_PERDITA_RESCUE=y
BR2_PACKAGE_DGPRESCUE_HAVE_ETH_RESCUE=y
BR2_PACKAGE_DGPRESCUE_HAVE_STATIC_ETH=y
```
